## conf/distro/tpl-boot.conf
```bitbake
require conf/distro/poky-tiny.conf

DISTRO          = "tpl-boot"
DISTROOVERRIDES = "poky:poky-tiny:tpl-boot"
```

## conf/layer.conf
```bitbake
# We have a conf and classes directory, add to BBPATH
BBPATH .= ":${LAYERDIR}"

# We have recipes-* directories, add to BBFILES
BBFILES += "${LAYERDIR}/recipes-*/*/*.bb \
            ${LAYERDIR}/recipes-*/*/*.bbappend"

BBFILE_COLLECTIONS += "archer-c5"
BBFILE_PATTERN_archer-c5 = "^${LAYERDIR}/"
BBFILE_PRIORITY_archer-c5 = "8"
```

## conf/machine/archer-c5.conf
```bitbake
require conf/machine/include/tune-mips32r2.inc

DEFAULTTUNE = "mips32r2-nf"

MULTI_PROVIDER_WHITELIST += "virtual/kernel"
PREFERRED_PROVIDER_virtual/kernel = "linux-tpl"
```
